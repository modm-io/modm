/*
 * Copyright (c) 2011-2012, Fabian Greif
 * Copyright (c) 2012, 2015-2016, Niklas Hauser
 * Copyright (c) 2013, Sascha Schade
 * Copyright (c) 2013, 2015, Kevin Läufer
 *
 * This file is part of the modm project.
 *
 * This Source Code Form is subject to the terms of the Mozilla Public
 * License, v. 2.0. If a copy of the MPL was not distributed with this
 * file, You can obtain one at http://mozilla.org/MPL/2.0/.
 */
/* ------------------------------------------------------------------------- */

/*
 *                           LINKER  SCRIPT
 *
 * The Linker Script defines how the code and data emitted by the GNU C compiler
 * and assembler are  to be loaded into memory (code goes into FLASH, variables
 * go into RAM).
 *
 * Any symbols defined in the Linker Script are automatically global and
 * available to the rest of the program.
 *
 * Example for STM32F746:
 *
 *                        MEMORY MAP (BACKUP)
 *
 * Backup internal SRAM (4 kB):
 *                |                                 | 0x4002 5000 <---- __backup_end
 *      +-------> |---------------------------------| 0x4002 4FFF
 *      |         |                                 |
 *   .backup      |                                 |
 *      |         |                                 |
 *      +-------> |---------------------------------| 0x4002 4000 <--- __backup_start
 *
 *                          MEMORY MAP (RAM)
 *
 * Auxiliary internal SRAM2 (16 kB):
 *   only accessible by CPU via S-Bus (less efficient than I-Bus), otherwise fully DMA capable
 *                |                                 | 0x2005 0000 <---- __ram_end, __heap2_end
 *      +-------> |---------------------------------| 0x2004 FFFF
 *      |         |                                 |
 *   .heap2       |                                 |
 *      |         |                                 |
 *      +-------> |---------------------------------| 0x2004 C000 <--- __heap2_start
 *
 *
 * Main internal SRAM1 (240 kB):
 *                |                                 | 0x2004 C000
 *      +-------> |---------------------------------| 0x2004 BFFF
 *      |         |                                 |
 *      |         |               ^                 |
 *   .heap1       |               |                 |
 *      |         |            Heap Area            |
 *      |         |         (grows upwards)         | <------- __heap1_start
 *      +-------> |---------------------------------| <------- __noinit_end
 *      |         |                                 |
 *   .noinit      |     Global data not cleared     |
 *      |         |           after reset           | <------- __noinit_start
 *      +-------> |---------------------------------| <------- __bss_end
 *      |         |                                 |
 *    .bss        |     uninitialized variables     |
 *      |         |                                 | <------- __bss_start
 *      +-------> |---------------------------------| <------- __data_end
 *      |         |                                 |
 *      |         |                                 |
 *    .data       |     initialized variables       |
 *      |         |                                 |
 *      |         |                                 | <------- __data_start
 *      +-------> |---------------------------------| 0x2001 0000 <--- __ram_start
 *
 *
 * DTCM (Data Tightly Coupled memory) (64 kB):
 *   accessible by DMA and the CPU via D-Bus, not I-Bus!
 *                |                                 | 0x2001 0000 <---- __heap0_end
 *      +-------> |---------------------------------| 0x2000 FFFF
 *      |         |                                 |
 *   .heap0       |           Unused RAM            |
 *      |         |                                 | <------- __heap0_start
 *      +-------> |---------------------------------| <------- __fastdata_end
 *      |         |                                 |
 *  .fastdata     |     initialized variables       |
 *      |         |                                 | <------- __fastdata_start
 *      +-------> |---------------------------------| <------- __process_stack_top, __stack_end
 *      |         |       Process Stack (psp)       |
 *      |         |       (grows downwards)         |
 *      |         |               |                 |
 *      |         |               v                 |
 *   .stack       |---------------------------------| <------- __main_stack_top
 *      |         |        Main Stack (msp)         |
 *      |         |       (grows downwards)         |
 *      |         |               |                 |
 *      |         |               v                 | <------- __stack_start
 *      +-------> |---------------------------------| 0x2000 0000
 *
 *
 *                          MEMORY MAP (Flash)
 *
 *                |                                 | 0x0802 0000 <--- __rom_end
 *                |---------------------------------| 0x0801 FFFF
 *                |                                 |
 *                |                                 |
 *                |                                 |
 *                |          Unused flash           |
 *                |                                 |
 *                |                                 |
 *                |                                 |
 *      +-------> |---------------------------------|
 *      |         |                                 |
 *      |         |                                 |
 *      |         |                                 |
 *    .data       |      copy of .data area         |
 *      |         |                                 |
 *      |         |                                 |
 *      |         |                                 | <------- __data_load
 *      +-------> |---------------------------------|
 *      |         |    Static Constructors (C++)    |
 *      |         | ------------------------------- |
 *      |         |                                 |
 *    .text       |                                 |
 *      |         |          C/C++ code             |
 *      |         |                                 |
 *      |         |                                 |
 *      +-------> |---------------------------------|
 *      |         |                                 |
 *  .fastdata     |     Variables to be loaded      |
 *      |         |         into DTCM RAM           | <------- __fastdata_load
 *      +-------> |---------------------------------|
 *      |         |                                 |
 *  .fastcode     |     C-Functions to be loaded    |
 *      |         |         into ITCM RAM           | <------- __fastcode_load
 *      +-------> |---------------------------------|
 *      |         |                                 |
 *   .reset       |   Interrupt Vectors (in FLASH)  |
 *      |         |       (copy of .vectors)        | <------- __vector_table_rom_start, __vector_table_ram_load
 *      +-------> |---------------------------------| 0x0800 0000 <--- __rom_start
 *
 * ITCM (Instruction Tightly Coupled Memory) (16 kB):
 *   only accessible by the CPU (no DMA etc.) via I-Bus!
 *                |                                 | 0x0000 4000 <---- __heap4_end
 *      +-------> |---------------------------------| 0x0000 3FFF
 *      |         |                                 |
 *   .heap4       |           Unused RAM            |
 *      |         |                                 | <------- __heap4_start
 *      +-------> |---------------------------------| <------- __fastcode_end
 *      |         |                                 |
 *  .fastcode     |     C/C++-Functions in RAM      |
 *      |         |                                 | <------- __fastcode_start
 *      +-------> |---------------------------------| <------- __vector_table_ram_end
 *      |         |                                 |
 *  .vectors      |    Interrupt Vectors (in RAM)   |
 *      |         |        (if re-mapped)           | <------- __vector_table_ram_start
 *      +-------> |---------------------------------| 0x0000 0000
 *
 * The first two words (32-bit) in the Flash defines the initial stack pointer
 * location and the reset handler location.
 */

%% import 'linker.macros' as linker with context
%% set regions = []

{{ linker.prefix(regions) }}


SECTIONS
{
	{{ linker.section_reset("FLASH") }}

	{{ linker.section_vectors("ITCM") }}

	{{ linker.section("ITCM AT >FLASH", "fastcode") }}

	{{ linker.section_heap("ITCM", "heap4") }}

	{{ linker.section_stack("DTCM", None) }}

	{{ linker.section("DTCM AT >FLASH", "fastdata") }}

	{{ linker.section_heap("DTCM", "heap0") }}

	{{ linker.section("BACKUP AT >FLASH", "backup") }}

	{{ linker.section_heap("BACKUP", "heap5") }}

	{{ linker.section_rom("FLASH") }}

	{{ linker.section_ram("RAM") }}

	{{ linker.section_heap("SRAM1", "heap1") }}

	{{ linker.section_heap("SRAM2", "heap2") }}

	{{ options["linkerscript.sections"] }}

	/* TABLES! TABLES! ALL THE TABLES YOU COULD EVER WANT! TABLES! */
	{{ linker.section_table_zero(["bss"]) }}

%% set copy_table = ["data", "fastdata", "fastcode"]
%% if vector_table_location == "ram"
	%% do copy_table.append("vector_table_ram")
%% endif
	{{ linker.section_table_copy(copy_table) }}

	{{ linker.section_table_extern() }}

%% set heap_table = [
		{'name': 'heap1', 'prop': '0x001f'},
		{'name': 'heap2', 'prop': '0x001f'},
		{'name': 'heap0', 'prop': '0x200f'},
		{'name': 'heap4', 'prop': '0x2005'},
		{'name': 'heap5', 'prop': '0x4009'}
	]
	{{ linker.section_table_heap(heap_table) }}

	{{ linker.section_end() }}

	{{ linker.section_debug() }}
}
