%% import "../../cortex/linker.macros" as linker with context
{{ linker.copyright() }}

{{ linker.prefix() }}


SECTIONS
{
{{ linker.section_rom_start("FLASH") }}

{{ linker.section_vector_rom("FLASH") }}

{{ linker.section_vector_ram("RAM") }}

{{ linker.section_stack("CCM") }}

	/* CCM can only be accessed by D-Bus, do not place .fastcode here! */
{{ linker.section("CCM AT >FLASH", "fastdata") }}

{{ linker.section_heap("CCM", "heap0") }}

%% if "backup" in regions
{{ linker.section("BACKUP AT >FLASH", "backup") }}

{{ linker.section_heap("BACKUP", "heap5") }}
%% endif

{{ linker.section_rom("FLASH") }}

{{ linker.section_ram("RAM", "FLASH", ["fastcode"]) }}

{{ linker.section_heap("SRAM1", "heap1", "RAM") }}

%% if "sram2" in regions
{{ linker.section_heap("SRAM2", "heap2", "RAM") }}
%% endif

%% if "sram3" in regions
{{ linker.section_heap("SRAM3", "heap3", "RAM") }}
%% endif
%% if with_crashcatcher
	g_crashCatcherStack = . - 500;
%% endif

{{ linkerscript_sections | indent(first=True) }}

	/* TABLES! TABLES! ALL THE TABLES YOU COULD EVER WANT! TABLES! */
{{ linker.section_table_zero("FLASH") }}

%% set copy_table = ["fastdata"]
%% if "backup" in regions
	%% do copy_table.append("backup")
%% endif
{{ linker.section_table_copy("FLASH", copy_table) }}

{{ linker.section_table_extern("FLASH") }}

%% set heap_table = [{"name": "heap1", "prop": "0x001f"}, {"name": "heap0", "prop": "0x2002"}]
%% if "sram3" in regions
	%% do heap_table.insert(1, {"name": "heap3", "prop": "0x0019"})
%% endif
%% if "sram2" in regions
	%% do heap_table.insert(1, {"name": "heap2", "prop": "0x0019"})
%% endif
%% if "backup" in regions
	%% do heap_table.insert(1, {"name": "heap5", "prop": "0x4009"})
%% endif
{{ linker.section_table_heap("FLASH", heap_table) }}

{{ linker.section_rom_end("FLASH") }}

{{ linker.section_debug() }}
}
