%% import "../../cortex/linker.macros" as linker with context
{{ linker.copyright() }}

{{ linker.prefix() }}


SECTIONS
{
{{ linker.section_rom_start("FLASH") }}

{{ linker.section_vector_rom("FLASH") }}

{{ linker.section_vector_ram("ITCM") }}

{{ linker.section("ITCM AT >FLASH", "fastcode") }}

{{ linker.section_heap("ITCM", "heap5") }}
%% if with_crashcatcher
	g_crashCatcherStack = . - 500;
%% endif

{{ linker.section_stack("DTCM") }}

{{ linker.section("DTCM AT >FLASH", "fastdata") }}

{{ linker.section_heap("DTCM", "heap0") }}

%% if "backup" in regions
{{ linker.section("BACKUP AT >FLASH", "backup") }}

{{ linker.section_heap("BACKUP", "heap6") }}
%% endif

{{ linker.section_rom("FLASH") }}

{{ linker.section_ram("RAM", "FLASH") }}

%% if "sram" in regions
{{ linker.section_heap("SRAM", "heap", "RAM") }}

{{ linker.section_heap("SRAM1", "heap1", "SRAM1") }}
{{ linker.section_heap("SRAM2", "heap2", "SRAM2") }}
{{ linker.section_heap("SRAM3", "heap3", "SRAM3") }}
{{ linker.section_heap("SRAM4", "heap4", "SRAM4") }}
%% else
{{ linker.section_heap("SRAM1", "heap1", "RAM") }}
{{ linker.section_heap("SRAM2", "heap2", "RAM") }}
%% endif

{{ linkerscript_sections | indent(first=True) }}

	/* TABLES! TABLES! ALL THE TABLES YOU COULD EVER WANT! TABLES! */
{{ linker.section_table_zero("FLASH") }}

{{ linker.section_table_copy("FLASH", ["fastcode"]) }}

{{ linker.section_table_extern("FLASH") }}

%% set heap_table = [
		{"name": "heap1", "prop": "0x001f"},
		{"name": "heap2", "prop": "0x001f"},
		{"name": "heap0", "prop": "0x200f"},
		{"name": "heap5", "prop": "0x2006"},
	]
%% if "sram3" in regions
	%% do heap_table.insert(1, {"name": "heap3", "prop": "0x001f"})
%% endif
%% if "sram4" in regions
	%% do heap_table.insert(1, {"name": "heap4", "prop": "0x001f"})
%% endif
%% if "backup" in regions
	%% do heap_table.insert(1, {"name": "heap6", "prop": "0x4009"})
%% endif
{{ linker.section_table_heap("FLASH", heap_table) }}

{{ linker.section_rom_end("FLASH") }}

{{ linker.section_debug() }}
}
