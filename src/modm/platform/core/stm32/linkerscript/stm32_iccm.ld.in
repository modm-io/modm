%% import "../../cortex/linker.macros" as linker with context
{{ linker.copyright() }}

{{ linker.prefix() }}


SECTIONS
{
{{ linker.section_rom_start() }}

{{ linker.section_vector_rom("FLASH") }}

{{ linker.section_vector_ram("CCM") }}

{{ linker.section("CCM AT >FLASH", "fastcode") }}

{{ linker.section("CCM AT >FLASH", "fastdata") }}

{{ linker.section_heap("CCM", "heap4") }}
%% if with_crashcatcher
	g_crashCatcherStack = . - 500;
%% endif

{{ linker.section_rom("FLASH") }}

{{ linker.section_stack("RAM") }}

{{ linker.section_ram("RAM") }}

{{ linker.section_heap("RAM", "heap1") }}

{{ linkerscript_sections | indent(first=True) }}

	/* TABLES! TABLES! ALL THE TABLES YOU COULD EVER WANT! TABLES! */
{{ linker.section_table_zero() }}

{{ linker.section_table_copy(["fastcode"]) }}

{{ linker.section_table_extern() }}

%% set heap_table = [
		{'name': 'heap1', 'prop': '0x000f'},
		{'name': 'heap4', 'prop': '0x2006'}]
{{ linker.section_table_heap(heap_table) }}

{{ linker.section_rom_end() }}

{{ linker.section_debug() }}
}
