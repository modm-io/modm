%% import "../cortex/linker.macros" as linker with context
{{ linker.copyright() }}

{{ linker.prefix() }}
%% set table_heap = []
%% set table_copy = []
%% set table_zero = []


SECTIONS
{
{{ linker.section_rom_start(cont_flash_name) }}

{{ linker.section_vector_rom(cont_flash_name) }}

{{ linker.section_rom(cont_flash_name) }}

{{ linker.section_stack(cont_ram_name) }}

{{ linker.section_ram(cont_ram_name, cont_flash_name, table_copy, table_zero,
                      sections_data=["data_" + cont_ram.contains[0].name],
                      sections_bss=["bss_" + cont_ram.contains[0].name],
                      sections_noinit=["faststack"]) }}

{{ linker.all_heap_sections(cont_flash_name, table_copy, table_zero, table_heap) }}
%% if with_crashcatcher
	%#
	/* Bottom of crash stack for `modm:platform:fault` */
	g_crashCatcherStack = . - 500;
	%#
%% endif

%% if vector_table_location == "ram"
{{ linker.section_vector_ram("CCM", table_copy) }}
%% endif

	/* Sections in memory region CCM */
{{ linker.section_load("CCM AT >" + cont_flash_name, table_copy, sections=["fastcode", "fastdata", "data_ccm"]) }}

{{ linker.section_heap("CCM", "heap_ccm", sections=["bss_ccm", "noinit_ccm"]) }}
%% do table_heap.append({"name": "heap_ccm", "prop": "0x2006"})
%% do table_zero.append("bss_ccm")

%% if linkerscript_sections
{{ linkerscript_sections | indent(first=True) }}
	%#
%% endif

{{ linker.section_tables(cont_flash_name, table_copy, table_zero, table_heap) }}

{{ linker.section_rom_end(cont_flash_name) }}

{{ linker.section_debug() }}
}
