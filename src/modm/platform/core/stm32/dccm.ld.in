%% import "../cortex/linker.macros" as linker with context
{{ linker.copyright() }}

{{ linker.prefix() }}
%% set table_heap = []
%% set table_copy = []
%% set table_zero = []

%% if vector_table_location == "ram"
/* Computes stack offset so that vector table is aligned */
__stack_offset = ALIGN(MAIN_STACK_SIZE, (1 << LOG2CEIL({{ highest_irq + 16 }})) * 8) - MAIN_STACK_SIZE;
%#
%% endif

SECTIONS
{
{{ linker.section_rom_start(cont_flash_name) }}

{{ linker.section_vector_rom(cont_flash_name) }}

{{ linker.section_rom(cont_flash_name) }}

{{ linker.section_stack(cont_ram_name, "__stack_offset" if vector_table_location == "ram" else None) }}

%% if vector_table_location == "ram"
{{ linker.section_vector_ram(cont_ram_name, table_copy) }}
%% endif

{{ linker.section_ram(cont_ram_name, cont_flash_name, table_copy, table_zero,
                      sections_data=["fastcode", "data_" + cont_ram.contains[0].name],
                      sections_bss=["bss_" + cont_ram.contains[0].name],
                      sections_noinit=["faststack"]) }}

{{ linker.all_heap_sections(cont_flash_name, table_copy, table_zero, table_heap) }}

%% if "backup" in regions
	/* Sections in memory region BACKUP */
{{ linker.section_load("BACKUP AT >" + cont_flash_name, table_copy, sections=["data_backup"]) }}

{{ linker.section_heap("BACKUP", "heap_backup", sections=["bss_backup", "noinit_backup"]) }}
	%% do table_heap.append({"name": "heap_backup", "prop": "0x4009"})
	%% do table_zero.append("bss_backup")
%% endif

	/* Sections in memory region CCM */
{{ linker.section_load("CCM AT >" + cont_flash_name, table_copy, sections=["fastdata", "data_ccm"]) }}

{{ linker.section_heap("CCM", "heap_ccm", sections=["bss_ccm", "noinit_ccm"]) }}
	%% do table_heap.append({"name": "heap_ccm", "prop": "0x2002"})
	%% do table_zero.append("bss_ccm")
%% if with_crashcatcher
	%#
	/* Bottom of crash stack for `modm:platform:fault` */
	g_crashCatcherStack = . - 500;
	%#
%% endif

%% if linkerscript_sections
{{ linkerscript_sections | indent(first=True) }}
	%#
%% endif

{{ linker.section_tables(cont_flash_name, table_copy, table_zero, table_heap) }}

{{ linker.section_rom_end(cont_flash_name) }}

{{ linker.section_debug() }}
}
