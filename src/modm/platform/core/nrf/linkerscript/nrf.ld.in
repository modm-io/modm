%% import "../../cortex/linker.macros" as linker with context
{{ linker.copyright() }}

{{ linker.prefix() }}
%% set table_heap = []
%% set table_copy = []
%% set table_zero = []

SECTIONS
{
{{ linker.section_rom_start("FLASH") }}

{{ linker.section_vector_rom("FLASH") }}

{{ linker.section_stack("RAM", "VECTOR_TABLE_OFFSET - TOTAL_STACK_SIZE") }}

{{ linker.section_vector_ram("RAM") }}

{{ linker.section_rom("FLASH") }}

{{ linker.section("FLASH", "fastcode") }}

{{ linker.section_ram("RAM", "FLASH") }}

{{ linker.section("RAM AT >FLASH", "fastdata") }}

{{ linker.section_heap("RAM", "heap1") }}

{{ linkerscript_sections | indent(first=True) }}

    /* TABLES! TABLES! ALL THE TABLES YOU COULD EVER WANT! TABLES! */
{{ linker.section_table_zero("FLASH") }}

{{ linker.section_table_copy("FLASH") }}

{{ linker.section_table_extern("FLASH") }}

%% set heap_table = [{"name": "heap1", "prop": "0x000f"}]
{{ linker.section_table_heap("FLASH", heap_table) }}

{{ linker.section_rom_end("FLASH") }}

{{ linker.section_debug() }}
}
